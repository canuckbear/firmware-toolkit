## dft-cli/debian/dft/usr/share/dft/board-support/linux-kernel-fragments/hardware/common/device-drivers/usb/common-usb.defconfig
```kconfig
# vim: ft=make ts=4 sw=4 noet
#
# The contents of this file are subject to the Apache 2.0 license you may not
# use this file except in compliance with the License.
#
# Software distributed under the License is distributed on an "AS IS" basis,
# WITHOUT WARRANTY OF ANY KIND, either express or implied. See the License
# for the specific language governing rights and limitations under the
# License.
#
#
# Copyright 2016 DFT project (http://www.firmwaretoolkit.org).
# All rights reserved. Use is subject to license terms.
#
#
# Contributors list :
#
#		William Bonnet	 	wllmbnnt@gmail.com, william@wbonnet.net
#       Jean-Marc Lacroix   jeanmarc.lacroix@free.fr
#
#

# CONFIG_USB_NET2272 is not set
CONFIG_USB_NET2280=m
CONFIG_USB_NET_AQC111=m
CONFIG_USB_NET_AX88179_178A=m
CONFIG_USB_NET_AX8817X=m
CONFIG_USB_NET_CDC_EEM=m
CONFIG_USB_NET_CDCETHER=m
CONFIG_USB_NET_CDC_MBIM=m
CONFIG_USB_NET_CDC_NCM=m
CONFIG_USB_NET_CDC_SUBSET_ENABLE=m
CONFIG_USB_NET_CDC_SUBSET=m
CONFIG_USB_NET_CH9200=m
CONFIG_USB_NET_CX82310_ETH=m
CONFIG_USB_NET_DM9601=m
CONFIG_USB_NET_DRIVERS=m
CONFIG_USB_NET_GL620A=m
CONFIG_USB_NET_HUAWEI_CDC_NCM=m
CONFIG_USB_NET_INT51X1=m
CONFIG_USB_NET_KALMIA=m
CONFIG_USB_NET_MCS7830=m
CONFIG_USB_NET_NET1080=m
CONFIG_USB_NET_PLUSB=m
CONFIG_USB_NET_QMI_WWAN=m
CONFIG_USB_NET_RNDIS_HOST=m
CONFIG_USB_NET_RNDIS_WLAN=m
CONFIG_USB_NET_SMSC75XX=m
CONFIG_USB_NET_SMSC95XX=m
CONFIG_USB_NET_SR9700=m
CONFIG_USB_NET_SR9800=m
CONFIG_USB_NET_ZAURUS=m
```

## dft-cli/debian/dft/usr/share/dft/board-support/linux-kernel-fragments/runtime_testing.defconfig
```kconfig
# vim: ft=make ts=4 sw=4 noet
#
# The contents of this file are subject to the Apache 2.0 license you may not
# use this file except in compliance with the License.
#
# Software distributed under the License is distributed on an "AS IS" basis,
# WITHOUT WARRANTY OF ANY KIND, either express or implied. See the License
# for the specific language governing rights and limitations under the
# License.
#
#
# Copyright 2016-2022 DFT project (http://www.firmwaretoolkit.org).
# All rights reserved. Use is subject to license terms.
#
#
# Contributors list :
#
#		William Bonnet	 	wllmbnnt@gmail.com, william@wbonnet.net
#       Jean-Marc Lacroix   jeanmarc.lacroix@free.fr
#
#

CONFIG_KPROBES_SANITY_TEST=n
CONFIG_BACKTRACE_SELF_TEST=n
CONFIG_RBTREE_TEST=n
CONFIG_INTERVAL_TREE_TEST=n
CONFIG_PERCPU_TEST=n
```

## trixie-upgrade-review/board-support/linux-kernel-fragments/functional/common/debug/debug_kernel_lockup_and_hangs.defconfig
```kconfig
# vim: ft=make ts=4 sw=4 noet
#
# The contents of this file are subject to the Apache 2.0 license you may not
# use this file except in compliance with the License.
#
# Software distributed under the License is distributed on an "AS IS" basis,
# WITHOUT WARRANTY OF ANY KIND, either express or implied. See the License
# for the specific language governing rights and limitations under the
# License.
#
#
# Copyright 2016-2022 DFT project (https://www.firmwaretoolkit.org).
# All rights reserved. Use is subject to license terms.
#
#
# Contributors list :
#
#		William Bonnet	 	wllmbnnt@gmail.com, william@wbonnet.net
#       Jean-Marc Lacroix   jeanmarc.lacroix@free.fr
#
#

CONFIG_SOFTLOCKUP_DETECTOR=n
CONFIG_DETECT_HUNG_TASK=n
CONFIG_WQ_WATCHDOG=n
CONFIG_SCHED_DEBUG=y
CONFIG_SCHED_DEBUG=y
CONFIG_SCHED_STACK_END_CHECK=y
```
